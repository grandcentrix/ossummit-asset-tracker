## CMakeLists.txt
```
cmake_minimum_required(VERSION 3.20.0)
find_package(Zephyr REQUIRED HINTS $ENV{ZEPHYR_BASE}) # creates target "app"

project(app LANGUAGES C)

target_compile_options(app PRIVATE
    -Wall
    -Werror
    -Wno-unused-parameter
)

target_sources(app PRIVATE
    src/gps.c
    src/lte.c
    src/main.c
    src/thingsboard.c
    src/payload.c
)
```

## Kconfig
```
mainmenu "Thingsboard Asset Tracker Configuration"

menu "Thingsboard Asset Tracker App"

# Add CONFIG_TBAT_LOG_LEVEL which defines the maximnum compiled-in loglevel for the app.
module = TBAT
module-str = Thingsboard Asset Tracker
source "subsys/logging/Kconfig.template.log_config"

config TBAT_THINGSBOARD_ACCESS_TOKEN
    string "Thingsboard access token"
    default ""
	help
		Thingsboard access token for the device.

config TBAT_THINGSBOARD_HOSTNAME
	string "CoAP server hostname"
	default "coap.thingsboard.cloud"
	help
		Hostname of the Thingsboard's CoAP server

config TBAT_THINGSBOARD_PORT
	int "CoAP server port"
	default 5683
	help
		Port of the Thingsboard's CoAP server

config TBAT_GPS_PERIODIC_INTERVAL
	int "Interval for periodic GPS fixes"
	range 10 65535
	default 120
	help
	  Interval (in seconds) for periodic fixes.

config TBAT_GPS_PERIODIC_TIMEOUT
	int "Timeout for periodic GPS fixes"
	range 0 65535
	default 60
	help
	  Tmeout (in seconds) for periodic fixes.
	  If set to zero, GPS is allowed to run indefinitely until a valid PVT estimate is produced.

endmenu

menu "Zephyr"
source "Kconfig.zephyr"
endmenu
```

## prj.conf
```kconfig
CONFIG_LOG=y

CONFIG_TBAT_LOG_LEVEL_INF=y

CONFIG_PICOLIBC_IO_FLOAT=y

CONFIG_NRF_MODEM_LIB=y
CONFIG_NRF_MODEM_LIB_LOG_FW_VERSION_UUID=y

CONFIG_MODEM_ANTENNA_GNSS_EXTERNAL=y

CONFIG_LTE_LINK_CONTROL=y
CONFIG_LTE_NETWORK_MODE_LTE_M_NBIOT_GPS=y
CONFIG_LTE_MODE_PREFERENCE_LTE_M=y
CONFIG_LTE_EDRX_REQ=y
CONFIG_LTE_PSM_REQ=y
CONFIG_LTE_PSM_REQ_FORMAT_SECONDS=y
CONFIG_LTE_PSM_REQ_RPTAU_SECONDS=1200
CONFIG_LTE_PSM_REQ_RAT_SECONDS=16

CONFIG_NETWORKING=y
CONFIG_NET_NATIVE=n
CONFIG_NET_IPV4=y
CONFIG_NET_IPV6=n
CONFIG_NET_SOCKETS=y
CONFIG_NET_SOCKETS_OFFLOAD=y
CONFIG_NET_SOCKETS_POSIX_NAMES=y

CONFIG_COAP=y
CONFIG_COAP_CLIENT=y
CONFIG_COAP_CLIENT_MAX_INSTANCES=1
CONFIG_COAP_CLIENT_MAX_REQUESTS=1
CONFIG_JSON_LIBRARY=y

CONFIG_DK_LIBRARY=y

CONFIG_SHELL=y
```

## debug.conf
```kconfig
CONFIG_DEBUG_OPTIMIZATIONS=y
CONFIG_THREAD_NAME=y
CONFIG_THREAD_ANALYZER=y
```

## trace.conf
```kconfig
CONFIG_NRF_MODEM_LIB_TRACE=y
CONFIG_NRF_MODEM_LIB_TRACE_BACKEND_UART=y
CONFIG_AT_HOST_LIBRARY=y
CONFIG_UART_ASYNC_API=y
```

## src/main.c
```c
#include "gps.h"
#include "lte.h"
#include "thingsboard.h"
#include "payload.h"

#include <dk_buttons_and_leds.h>
#include <modem/nrf_modem_lib.h>
#include <zephyr/kernel.h>
#include <zephyr/logging/log.h>

#include <string.h>

LOG_MODULE_REGISTER(main, CONFIG_TBAT_LOG_LEVEL);

K_SEM_DEFINE(lte_connected, 0, 1);

struct gps_work_info {
	struct k_work work;
	struct gps_fix gps_fix;
} gps_work_info;

static char payload_buf[1024];

static void lte_connected_cb()
{
	k_sem_give(&lte_connected);
}

void gps_worker(struct k_work *item)
{
	struct gps_work_info *work_info = CONTAINER_OF(item, struct gps_work_info, work);
	int err;

	err = payload_encode_gps_fix(&work_info->gps_fix, payload_buf, sizeof(payload_buf));
	if (err) {
		return;
	}

	LOG_INF("Sending GPS telemetry: %s", payload_buf);

	err = tb_send_telemetry(payload_buf, CONFIG_TBAT_THINGSBOARD_ACCESS_TOKEN);
	if (err) {
		LOG_ERR("Failed to send GPS telemetry, error %d", err);
	}
}

static void gps_fix_cb(const struct gps_fix *gps_fix)
{
	gps_work_info.gps_fix = *gps_fix;
	k_work_submit(&gps_work_info.work);
}

int main(void)
{
	int err;

	if (strlen(CONFIG_TBAT_THINGSBOARD_ACCESS_TOKEN) == 0) {
		LOG_ERR("No access token configured");
		return -1;
	}

	err = dk_leds_init();
	if (err) {
		LOG_ERR("Could not initialize DK LEDs, error (%d): %s", err, strerror(-err));
		return err;
	}

	k_work_init(&gps_work_info.work, gps_worker);

	LOG_INF("Initializing modem library");
	err = nrf_modem_lib_init();
	if (err) {
		LOG_ERR("Failed to initialize the modem library, error (%d): %s", err,
			strerror(-err));
		return err;
	}

	lte_set_connected_callback(&lte_connected_cb);

	err = lte_connect();
	if (err) {
		return err;
	}

	// Wait until modem is connected
	err = k_sem_take(&lte_connected, K_FOREVER);
	if (err) {
		LOG_ERR("Could not wait for LTE connection, error (%d): %s", err, strerror(-err));
		return err;
	}

	err = tb_init(CONFIG_TBAT_THINGSBOARD_HOSTNAME, CONFIG_TBAT_THINGSBOARD_PORT);
	if (err) {
		return err;
	}

	err = gps_start(&gps_fix_cb, CONFIG_TBAT_GPS_PERIODIC_INTERVAL,
			CONFIG_TBAT_GPS_PERIODIC_TIMEOUT);
	if (err) {
		return err;
	}

	LOG_DBG("Initialization complete. Exiting main thread");

	return err;
}
```

## src/gps.c
```c
#include "gps.h"

#include <modem/lte_lc.h>
#include <nrf_modem_gnss.h>
#include <zephyr/logging/log.h>
#include <zephyr/shell/shell.h>

#include <stdlib.h>
#include <stdio.h>
#include <string.h>

LOG_MODULE_REGISTER(gps, CONFIG_TBAT_LOG_LEVEL);

static struct nrf_modem_gnss_pvt_data_frame pvt_data;
static struct gps_fix gps_fix;
static gps_fix_callback_t on_gps_fix;

static int gps_fix_new(struct gps_fix *gps_fix, struct nrf_modem_gnss_pvt_data_frame *pvt_data)
{
	int ret;

	gps_fix->timestamp[0] = '\0';
	gps_fix->latitude = 0;
	gps_fix->longitude = 0;

	ret = snprintf(gps_fix->timestamp, sizeof(gps_fix->timestamp),
		       "%04u-%02u-%02uT%02u:%02u:%02uZ", pvt_data->datetime.year,
		       pvt_data->datetime.month, pvt_data->datetime.day, pvt_data->datetime.hour,
		       pvt_data->datetime.minute, pvt_data->datetime.seconds);
	if (ret < 0 || ret == sizeof(gps_fix->timestamp)) {
		return -EINVAL;
	}
	gps_fix->latitude = pvt_data->latitude;
	gps_fix->longitude = pvt_data->longitude;
	return 0;
}

static void handle_gps_event(int event)
{
	int err;

	switch (event) {
	// PVT data available
	case NRF_MODEM_GNSS_EVT_PVT:
		// Count number of satellites
		size_t num_satellites = 0;
		for (size_t i = 0; i < ARRAY_SIZE(pvt_data.sv); i++) {
			if (pvt_data.sv[i].signal != 0) {
				num_satellites++;
			}
		}
		LOG_DBG("Number of current satellites: %d", num_satellites);

		// Read PVT data
		err = nrf_modem_gnss_read(&pvt_data, sizeof(pvt_data), NRF_MODEM_GNSS_DATA_PVT);
		if (err) {
			LOG_ERR("reading PVT data failed, error (%d): %s", err, strerror(-err));
			break;
		}

		if (pvt_data.flags & NRF_MODEM_GNSS_PVT_FLAG_DEADLINE_MISSED) {
			LOG_DBG("GPS blocked by LTE activity");
		} else if (pvt_data.flags & NRF_MODEM_GNSS_PVT_FLAG_NOT_ENOUGH_WINDOW_TIME) {
			LOG_DBG("Insufficient GPS time windows");
		} else if (pvt_data.flags & NRF_MODEM_GNSS_PVT_FLAG_FIX_VALID) {
			err = gps_fix_new(&gps_fix, &pvt_data);
			if (err) {
				LOG_ERR("Couldn't save GPS fix, error (%d): %s", err,
					strerror(-err));
			}
			if (on_gps_fix) {
				on_gps_fix(&gps_fix);
			}
		}

		break;
	case NRF_MODEM_GNSS_EVT_PERIODIC_WAKEUP:
		LOG_DBG("GPS has woken up");
		break;
	case NRF_MODEM_GNSS_EVT_SLEEP_AFTER_TIMEOUT:
		LOG_DBG("GPS enters sleep after fix timeout");
		break;
	case NRF_MODEM_GNSS_EVT_SLEEP_AFTER_FIX:
		LOG_DBG("GPS enters sleep after achieving fix");
		break;
	case NRF_MODEM_GNSS_EVT_BLOCKED:
		LOG_DBG("GPS is blocked by LTE activity");
		break;
	default:
		break;
	}
}

int gps_start(gps_fix_callback_t cb, uint16_t fix_interval, uint16_t fix_timeout)
{
	int err;

	on_gps_fix = cb;

	err = lte_lc_func_mode_set(LTE_LC_FUNC_MODE_ACTIVATE_GNSS);
	if (err) {
		LOG_ERR("Failed to activate GPS, error (%d): %s", err, strerror(-err));
		return err;
	}

	err = nrf_modem_gnss_event_handler_set(handle_gps_event);
	if (err) {
		LOG_ERR("Failed to set GPS event handler, error (%d): %s", err, strerror(-err));
		return err;
	}

	err = nrf_modem_gnss_fix_interval_set(fix_interval);
	if (err) {
		LOG_ERR("Failed to set GPS fix interval, error (%d): %s", err, strerror(-err));
		return err;
	}

	err = nrf_modem_gnss_fix_retry_set(fix_timeout);
	if (err) {
		LOG_ERR("Failed to set GPS fix retry, error (%d): %s", err, strerror(-err));
		return err;
	}

	LOG_INF("Starting GPS");
	err = nrf_modem_gnss_start();
	if (err) {
		LOG_ERR("Failed to start GPS, error (%d): %s", err, strerror(-err));
		return err;
	}

	return 0;
}

#ifdef CONFIG_SHELL

static struct gps_fix fake_gps_fix;

static int cmd_gps(const struct shell *shell, size_t argc, char **argv)
{
	double latitude = atof(argv[1]);
	double longitude = atof(argv[2]);

	if (latitude == 0.0 || longitude == 0.0) {
		shell_print(shell, "Entered GPS coordinates not valid.");
		return -1;
	}

	fake_gps_fix.latitude = latitude;
	fake_gps_fix.longitude = longitude;

	if (strlen(argv[3]) != sizeof(fake_gps_fix.timestamp) - 1) {
		shell_print(
			shell,
			"Timestamp has incorrect length. Expects an ISO8061 time stamp in UTC.");
		shell_print(shell, "For example: 2024-02-12T11:10:37Z");
		return -1;
	}

	strcpy(fake_gps_fix.timestamp, argv[3]);

	if (on_gps_fix) {
		on_gps_fix(&fake_gps_fix);
	}

	return 0;
}

SHELL_CMD_ARG_REGISTER(gps, NULL,
		       "Send a fake GPS position to thingsboard (usage: gps LAT LONG ISO8061_TIME)",
		       cmd_gps, 4, 0);

#endif // CONFIG_SHELL
```

## src/gps.h
```c
#ifndef TBAT_GPS_H
#define TBAT_GPS_H

#include <stdint.h>

struct gps_fix {
	double latitude;
	double longitude;
	// ISO8061 formatted string
	char timestamp[21];
};

typedef void (*gps_fix_callback_t)(const struct gps_fix *);

int gps_start(gps_fix_callback_t cb, uint16_t fix_interval, uint16_t fix_timeout);

#endif // TBAT_GPS_H
```

## src/lte.c
```c
#include "lte.h"

#include <dk_buttons_and_leds.h>
#include <modem/lte_lc.h>
#include <zephyr/logging/log.h>

#include <string.h>

LOG_MODULE_REGISTER(lte, CONFIG_TBAT_LOG_LEVEL);

#define LED_LTE DK_LED1

static lte_status_callback_t on_lte_connected;

static void handle_event(const struct lte_lc_evt *const evt);
static void registration_status_changed(enum lte_lc_nw_reg_status status);

void lte_set_connected_callback(lte_status_callback_t cb)
{
	on_lte_connected = cb;
}

int lte_connect(void)
{
	int err;

	err = lte_lc_func_mode_set(LTE_LC_FUNC_MODE_ACTIVATE_LTE);
	if (err) {
		LOG_ERR("Failed to activate LTE, error (%d): %s", err, strerror(-err));
		return err;
	}

	lte_lc_register_handler(handle_event);

	LOG_INF("Connecting to LTE network");
	err = lte_lc_connect_async(NULL);
	if (err) {
		LOG_ERR("Error in lte_lc_connect_async, error (%d): %s", err, strerror(-err));
		return err;
	}

	return 0;
}

static void handle_event(const struct lte_lc_evt *const evt)
{
	if (evt->type == LTE_LC_EVT_NW_REG_STATUS) {
		registration_status_changed(evt->nw_reg_status);
	}
}

static void log_registration_status(enum lte_lc_nw_reg_status status)
{
	char *status_str;

	switch (status) {
	case LTE_LC_NW_REG_REGISTERED_HOME:
		status_str = "registered - home network";
		break;
	case LTE_LC_NW_REG_REGISTERED_ROAMING:
		status_str = "registered - roaming";
		break;
	case LTE_LC_NW_REG_SEARCHING:
		status_str = "not registered - searching";
		break;
	case LTE_LC_NW_REG_NOT_REGISTERED:
		status_str = "not registered - not searching";
		break;
	case LTE_LC_NW_REG_REGISTRATION_DENIED:
		status_str = "not registered - denied";
		break;
	case LTE_LC_NW_REG_UICC_FAIL:
		status_str = "not registered - UICC failure";
		break;
	case LTE_LC_NW_REG_UNKNOWN:
		status_str = "unknown";
		break;
	default:
		status_str = "-";
		break;
	}
	LOG_INF("Network registration status: %s", status_str);
}

static void registration_status_changed(enum lte_lc_nw_reg_status status)
{
	log_registration_status(status);

	if (status == LTE_LC_NW_REG_REGISTERED_HOME || status == LTE_LC_NW_REG_REGISTERED_ROAMING) {
		dk_set_led_on(LED_LTE);
		if (on_lte_connected) {
			on_lte_connected();
		}
	} else {
		dk_set_led_off(LED_LTE);
	}
}
```

## src/lte.h
```c
#ifndef TBAT_LTE_H
#define TBAT_LTE_H

typedef void (*lte_status_callback_t)(void);

void lte_set_connected_callback(lte_status_callback_t cb);
int lte_connect(void);

#endif // TBAT_LTE_H
```

## src/payload.c
```c
#include "payload.h"

#include <zephyr/data/json.h>
#include <zephyr/logging/log.h>

#include <stdio.h>

LOG_MODULE_REGISTER(thingsboard_data, CONFIG_TBAT_LOG_LEVEL);

// Encoding a struct with floating point values is complicated with Zephyr's json library.
// Instead of struct gps_fix we use this struct for encoding which contains latitude and longitude
// as strings.
struct json_gps_fix {
	char *latitude;
	char *longitude;
	const char *gps_timestamp;
};

struct json_obj_descr json_gps_fix_descr[] = {
	JSON_OBJ_DESCR_PRIM(struct json_gps_fix, latitude, JSON_TOK_STRING),
	JSON_OBJ_DESCR_PRIM(struct json_gps_fix, longitude, JSON_TOK_STRING),
	JSON_OBJ_DESCR_PRIM(struct json_gps_fix, gps_timestamp, JSON_TOK_STRING),
};

int payload_encode_gps_fix(const struct gps_fix *gps_fix, char *json_buf, size_t json_buf_len)
{
	int err;
	struct json_gps_fix json_gps_fix;
	char buf_latitude[11] = {0};
	char buf_longitude[11] = {0};

	json_gps_fix.latitude = buf_latitude;
	json_gps_fix.longitude = buf_longitude;
	json_gps_fix.gps_timestamp = gps_fix->timestamp;

	sprintf(json_gps_fix.latitude, "%3.07f", gps_fix->latitude);
	sprintf(json_gps_fix.longitude, "%3.07f", gps_fix->longitude);

	err = json_obj_encode_buf(json_gps_fix_descr, ARRAY_SIZE(json_gps_fix_descr), &json_gps_fix,
				  json_buf, json_buf_len);
	if (err) {
		LOG_ERR("Failed to encode gps fix as JSON, error: %s (%d)", strerror(-err), err);
		return err;
	}

	return 0;
}
```

## src/payload.h
```c
#ifndef TBAT_PAYLOAD_H
#define TBAT_PAYLOAD_H

#include <stddef.h>

#include "gps.h"

int payload_encode_gps_fix(const struct gps_fix *gps_fix, char *json_buf, size_t json_buf_len);

#endif // TBAT_PAYLOAD_H
```

## src/thingsboard.c
```c
#include "thingsboard.h"

#include <zephyr/logging/log.h>
#include <zephyr/net/coap.h>
#include <zephyr/net/coap_client.h>
#include <zephyr/net/socket.h>

#include <string.h>

LOG_MODULE_REGISTER(thingsboard, CONFIG_TBAT_LOG_LEVEL);

#define MAX_COAP_URI_PATH_LEN 256

static int sock;
static struct sockaddr_storage server_addr;
static struct coap_client client;
static struct coap_client_request request;

static void ipv4_addr_to_str(struct sockaddr_in *addr, char addr_str[NET_IPV4_ADDR_LEN])
{
	inet_ntop(AF_INET, &addr->sin_addr.s_addr, addr_str, NET_IPV4_ADDR_LEN);
}

static int resolve_host(char *hostname, uint16_t port)
{
	int err;
	struct addrinfo *result;
	struct addrinfo hints = {.ai_family = AF_INET, .ai_socktype = SOCK_DGRAM};
	char ipv4_addr_str[NET_IPV4_ADDR_LEN];
	struct sockaddr_in *server_addr4;

	err = getaddrinfo(hostname, NULL, &hints, &result);
	if (err) {
		LOG_ERR("getaddrinfo failed %d", err);
		return err;
	}

	if (result == NULL) {
		LOG_ERR("Address not found");
		return -ENOENT;
	}

	server_addr4 = ((struct sockaddr_in *)&server_addr);
	server_addr4->sin_addr.s_addr = ((struct sockaddr_in *)result->ai_addr)->sin_addr.s_addr;
	server_addr4->sin_family = AF_INET;
	server_addr4->sin_port = htons(port);

	ipv4_addr_to_str(server_addr4, ipv4_addr_str);
	LOG_INF("Resolved %s to %s", hostname, ipv4_addr_str);

	freeaddrinfo(result);

	return 0;
}

static void decode_response_code(int16_t code, int *class, int *detail)
{
	*class = (code & 0xff) >> 5;
	*detail = code & 0x1f;
}

static void response_code_to_str(int16_t code, char str[5])
{
	int class, detail;
	decode_response_code(code, &class, &detail);
	sprintf(str, "%1d.%02d", class, detail);
}

void handle_response(int16_t result_code, size_t offset, const uint8_t *payload, size_t len,
		     bool last_block, void *user_data)
{
	ARG_UNUSED(offset);
	ARG_UNUSED(payload);
	ARG_UNUSED(len);
	ARG_UNUSED(last_block);
	ARG_UNUSED(user_data);

	char code_str[15];
	response_code_to_str(result_code, code_str);
	LOG_INF("Received response with code %s", code_str);
}

int tb_init(char *hostname, uint16_t port)
{
	int err;

	LOG_INF("Initializing socket for coap://%s:%d", hostname, port);

	err = resolve_host(hostname, port);
	if (err) {
		return err;
	}

	sock = socket(AF_INET, SOCK_DGRAM, IPPROTO_UDP);
	if (sock < 0) {
		LOG_ERR("Failed to create socket for CoAP communication, error (%d): %s", errno,
			strerror(errno));
		return -errno;
	}

	/*
	 * Not using connect() here to associate the socket with a server address.
	 * Depending on the server's configuration it can happen that the source address of the
	 * responses might not match the server address. In that case recv() is not able to
	 * receive the message if the socket is connected to that specific server address.
	 */

	err = coap_client_init(&client, NULL);
	if (err) {
		LOG_ERR("Failed initialize CoAP client, error (%d): %s", err, strerror(-err));
		return err;
	}

	return 0;
}

int tb_send_telemetry(char *payload, char *access_token)
{
	int err;
	char path[MAX_COAP_URI_PATH_LEN];

	if (!sock) {
		LOG_ERR("Socket not initialized. tb_init must be called first.");
		return -1;
	}

	err = snprintf(path, sizeof(path), "api/v1/%s/telemetry", access_token);
	if (err < 0 || err == sizeof(path)) {
		LOG_ERR("Failed to create URI string");
		return -EINVAL;
	}

	request.method = COAP_METHOD_POST;
	request.confirmable = false;
	request.path = path;
	request.fmt = COAP_CONTENT_FORMAT_APP_JSON;
	request.payload = (uint8_t *)payload;
	request.len = strlen(payload);
	request.cb = handle_response;

	err = coap_client_req(&client, sock, (struct sockaddr *)&server_addr, &request, NULL);
	if (err < 0) {
		LOG_ERR("Failed to send CoAP request, error (%d): %s", err, strerror(-err));
		return err;
	}

	return 0;
}

void tb_close(void)
{
	coap_client_cancel_requests(&client);
	close(sock);
}
```

## src/thingsboard.h
```c
#ifndef TBAT_THINGSBOARD_H
#define TBAT_THINGSBOARD_H

#include <stdint.h>

int tb_init(char *hostname, uint16_t port);
int tb_send_telemetry(char *payload, char *access_token);
void tb_close(void);

#endif // TBAT_THINGSBOARD_H
```
